## config/boards/shields/ergoz/Kconfig.defconfig
```kconfig
# Copyright (c) 2021 The ZMK Contributors
# SPDX-License-Identifier: MIT

if SHIELD_ERGOZ_LEFT

config ZMK_KEYBOARD_NAME
	default "ErgoZ"

config ZMK_SPLIT_ROLE_CENTRAL
	default y
	
endif

if SHIELD_ERGOZ_LEFT || SHIELD_ERGOZ_RIGHT

config ZMK_SPLIT
	default y

endif
```

## config/boards/shields/ergoz/Kconfig.shield
```kconfig
# Copyright (c) 2021 The ZMK Contributors
# SPDX-License-Identifier: MIT

config SHIELD_ERGOZ_LEFT
	def_bool $(shields_list_contains,ergoz_left)

config SHIELD_ERGOZ_RIGHT
	def_bool $(shields_list_contains,ergoz_right)
```
